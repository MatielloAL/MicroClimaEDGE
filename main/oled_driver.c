#include "oled_driver.h"
#include <string.h>
#include <stdio.h>
#include <stdarg.h>
#include "esp_log.h"

static const char *TAG = "oled";
static i2c_master_dev_handle_t s_dev;
static uint8_t s_buffer[128 * 64 / 8];
static uint8_t s_cursor_col = 0;
static uint8_t s_cursor_linha = 0;

// Fonte 5x7 (5 colunas x 8 bits, bit0=topo), ASCII 0x20-0x5F (espaco ate underscore),
// cobre digitos, maiusculas e simbolos usados no display. Dado de fonte bitmap
// generico de dominio publico, sem dependencia de nenhuma API/framework.
static const uint8_t FONTE_5X7[][5] = {
    {0x00,0x00,0x00,0x00,0x00}, // 0x20 espaco
    {0x00,0x00,0x5F,0x00,0x00}, // !
    {0x00,0x07,0x00,0x07,0x00}, // "
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    {0x40,0x40,0x40,0x40,0x40}, // _
};
#define FONTE_PRIMEIRO_CHAR 0x20
#define FONTE_ULTIMO_CHAR   0x5F

static void oled_cmd(uint8_t cmd) {
    uint8_t buf[2] = {0x00, cmd};
    i2c_master_transmit(s_dev, buf, sizeof(buf), 100);
}

bool oled_init(i2c_master_bus_handle_t bus, uint8_t endereco) {
    i2c_device_config_t dev_cfg = {
        .dev_addr_length = I2C_ADDR_BIT_LEN_7,
        .device_address = endereco,
        .scl_speed_hz = 400000,
    };
    if (i2c_master_bus_add_device(bus, &dev_cfg, &s_dev) != ESP_OK) {
        ESP_LOGE(TAG, "Falha ao adicionar OLED no barramento (0x%02X)", endereco);
        return false;
    }

    if (i2c_master_probe(bus, endereco, 100) != ESP_OK) {
        ESP_LOGE(TAG, "OLED nao respondeu em 0x%02X", endereco);
        return false;
    }

    oled_cmd(0xAE);
    oled_cmd(0xD5); oled_cmd(0x80);
    oled_cmd(0xA8); oled_cmd(0x3F);
    oled_cmd(0xD3); oled_cmd(0x00);
    oled_cmd(0x40);
    oled_cmd(0x8D); oled_cmd(0x14);
    oled_cmd(0x20); oled_cmd(0x00);
    oled_cmd(0xA1);
    oled_cmd(0xC8);
    oled_cmd(0xDA); oled_cmd(0x12);
    oled_cmd(0x81); oled_cmd(0xCF);
    oled_cmd(0xD9); oled_cmd(0xF1);
    oled_cmd(0xDB); oled_cmd(0x40);
    oled_cmd(0x2E);
    oled_cmd(0xA4);
    oled_cmd(0xAF);

    oled_clear();
    oled_display();
    return true;
}

void oled_clear(void) {
    memset(s_buffer, 0, sizeof(s_buffer));
    s_cursor_col = 0;
    s_cursor_linha = 0;
}

void oled_set_cursor(uint8_t coluna, uint8_t linha_de_texto) {
    s_cursor_col = coluna;
    s_cursor_linha = linha_de_texto;
}

static void desenhar_char(char c) {
    if (s_cursor_col > 128 - 6) return; // nao cabe mais nessa linha

    const uint8_t *glifo;
    static const uint8_t vazio[5] = {0, 0, 0, 0, 0};
    if (c >= FONTE_PRIMEIRO_CHAR && c <= FONTE_ULTIMO_CHAR) {
        glifo = FONTE_5X7[(uint8_t)c - FONTE_PRIMEIRO_CHAR];
    } else {
        glifo = vazio;
    }

    uint16_t base = (uint16_t)s_cursor_linha * 128 + s_cursor_col;
    for (int i = 0; i < 5; i++) {
        s_buffer[base + i] = glifo[i];
    }
    s_buffer[base + 5] = 0x00; // espaco entre chars

    s_cursor_col += 6;
}

void oled_print(const char *texto) {
    while (*texto) {
        char c = *texto++;
        if (c >= 'a' && c <= 'z') c -= 32; // so temos maiusculas na fonte
        desenhar_char(c);
    }
}

void oled_printf(const char *fmt, ...) {
    char buf[32];
    va_list args;
    va_start(args, fmt);
    vsnprintf(buf, sizeof(buf), fmt, args);
    va_end(args);
    oled_print(buf);
}

void oled_display(void) {
    for (uint8_t pagina = 0; pagina < 8; pagina++) {
        oled_cmd(0xB0 + pagina);
        oled_cmd(0x00);
        oled_cmd(0x10);

        uint8_t buf[129];
        buf[0] = 0x40;
        memcpy(&buf[1], &s_buffer[pagina * 128], 128);
        i2c_master_transmit(s_dev, buf, sizeof(buf), 100);
    }
}
