## main/sdkconfig.defaults
```kconfig
CONFIG_AUTOSTART_ARDUINO=y
CONFIG_FREERTOS_HZ=1000
CONFIG_COMPILER_DISABLE_GCC8_WARNINGS=y
CONFIG_COMPILER_OPTIMIZATION_ASSERTIONS_DISABLE=y
```

## sdkconfig.defaults
```kconfig
CONFIG_FREERTOS_HZ=1000
CONFIG_COMPILER_DISABLE_GCC8_WARNINGS=y
CONFIG_COMPILER_OPTIMIZATION_ASSERTIONS_DISABLE=y
CONFIG_COMPILER_WARNINGS_AS_ERRORS=n
CONFIG_MBEDTLS_KEY_EXCHANGE_PSK=y
```
